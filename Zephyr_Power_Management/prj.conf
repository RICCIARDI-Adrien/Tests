## CMakeLists.txt
```
# Copyright (c) 2024 Nordic Semiconductor ASA
# SPDX-License-Identifier: Apache-2.0

cmake_minimum_required(VERSION 3.20.0)
find_package(Zephyr REQUIRED HINTS $ENV{ZEPHYR_BASE})

project(power_management)
target_sources(app PRIVATE src/main.c)
```

## prj.conf
```kconfig
# Allow the Radio core image to run
CONFIG_SOC_NRF54H20_CPURAD_ENABLE=y

CONFIG_PM_DEVICE=y
CONFIG_PM=y
```

## app.overlay
```dts
// Remove the suspend to RAM state
&cpuapp {
	cpu-power-states = < &idle_cache_disabled >;
};
/ {
	cpus {
		power-states {
			/delete-node/ s2ram;
		};
	};
};
```

## src/main.c
```c
#include <zephyr/kernel.h>

int main(void)
{
	printk("Board %s has booted and is going to suspend to idle.\n", CONFIG_BOARD_TARGET);

	k_sleep(K_FOREVER);
	return 0;
}
```
